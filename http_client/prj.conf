## CMakeLists.txt
```
# SPDX-License-Identifier: Apache-2.0

cmake_minimum_required(VERSION 3.20.0)
find_package(Zephyr REQUIRED HINTS $ENV{ZEPHYR_BASE})
project(http_client)

FILE(GLOB app_sources src/*.c)
target_sources(app PRIVATE ${app_sources})

set(gen_dir ${ZEPHYR_BINARY_DIR}/include/generated/)

generate_inc_file_for_target(
    app
    src/https-cert.der
    ${gen_dir}/https-cert.der.inc
    )
```

## prj.conf
```kconfig
# Networking config
CONFIG_NETWORKING=y
CONFIG_NET_IPV4=y
CONFIG_NET_IPV6=y
CONFIG_NET_TCP=y
CONFIG_NET_SHELL=y

# Sockets
CONFIG_NET_SOCKETS=y
CONFIG_NET_SOCKETS_POSIX_NAMES=y
CONFIG_NET_SOCKETS_POLL_MAX=4
CONFIG_POSIX_API=y
# Network driver config
CONFIG_TEST_RANDOM_GENERATOR=y

# Network address config
CONFIG_NET_CONFIG_SETTINGS=y
CONFIG_NET_CONFIG_NEED_IPV4=y
CONFIG_NET_CONFIG_NEED_IPV6=y
CONFIG_NET_CONFIG_MY_IPV4_ADDR="192.0.2.1"
CONFIG_NET_CONFIG_MY_IPV4_GW="192.0.2.2"
# Address of HTTP IPv4 server
CONFIG_NET_CONFIG_PEER_IPV4_ADDR="192.0.2.2"
CONFIG_NET_CONFIG_MY_IPV6_ADDR="2001:db8::1"
# Address of HTTP IPv6 server
CONFIG_NET_CONFIG_PEER_IPV6_ADDR="2001:db8::2"

# HTTP
CONFIG_HTTP_CLIENT=y

# Network debug config
CONFIG_LOG=y
CONFIG_LOG_MODE_IMMEDIATE=y
CONFIG_NET_LOG=y
CONFIG_NET_SOCKETS_LOG_LEVEL_DBG=n
CONFIG_NET_HTTP_LOG_LEVEL_DBG=y

CONFIG_MAIN_STACK_SIZE=2048

CONFIG_BOOTLOADER_MCUBOOT=y
```

## src/main.c
```c
#include <zephyr/net/net_core.h>
#include <zephyr/net/net_ip.h>
#include <zephyr/net/socket.h>
#include <zephyr/net/http_client.h>

#define SERVER_HOST  "granlund.protopaja.aalto.fi"
#define SERVER_PORT  80
#define SERVER_URL   "https://granlund.protopaja.aalto.fi"
#define POST_DATA    "key1=value1&key2=value2"


void main(void)
{
    struct sockaddr_in server_addr;
    static struct http_request req;
    static char response[1024];

    /* Initialize the server address struct */
    server_addr.sin_family = AF_INET;
    server_addr.sin_port = htons(SERVER_PORT);
    inet_pton(AF_INET, SERVER_HOST, &server_addr.sin_addr);

    /* Prepare HTTP request */
    req.method = HTTP_POST;
    req.url = SERVER_URL;
    req.protocol = "HTTP/1.1";
    req.host = SERVER_HOST;
    req.header_fields = NULL;
    req.content = POST_DATA;
    req.content_len = strlen(POST_DATA);
    req.response = response;
    req.response_len = sizeof(response);

    /* Send HTTP POST request */
    int client_fd = socket(AF_INET, SOCK_STREAM, 0);
    connect(client_fd, (struct sockaddr *)&server_addr, sizeof(server_addr));
    http_client_req(client_fd, &req, K_FOREVER, NULL);

    /* Log the response */
    printk("HTTP Response: %s\n", response);

    /* Close socket */
    close(client_fd);
}
```
