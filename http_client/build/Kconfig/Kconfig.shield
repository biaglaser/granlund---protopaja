## http_client/build/Kconfig/Kconfig.shield
```kconfig
osource "c:/nordicapps/https_client16aug/boards/shields/*/Kconfig.shield"
osource "C:/ncs/v2.2.0/nrf/boards/shields/*/Kconfig.shield"
```

## http_client/build/Kconfig/Kconfig.shield.defconfig
```kconfig
osource "c:/nordicapps/https_client16aug/boards/shields/*/Kconfig.defconfig"
osource "C:/ncs/v2.2.0/nrf/boards/shields/*/Kconfig.defconfig"
```
